#include <U8g2lib.h>
#include <PulseSensorPlayground.h>
#include<Wire.h>
#include "RTClib.h"




#define USE_ARDUINO_INTERRUPTS true

#define PulseWire A0
#define Threshold 700
#define leftButton 6
#define selectButton 8
#define rightButton 7
#define MPU 0x69



// 'Menu1_Resized', 128x52px
const unsigned char epd_bitmap_Menu1_Resized [] U8X8_PROGMEM = {
	0x00, 0x00, 0x00, 0x00, 0x00, 0x00, 0x00, 0x00, 0x00, 0x00, 0x00, 0x00, 0x00, 0x00, 0x00, 0x00, 
	0x00, 0x00, 0x00, 0x00, 0x00, 0x00, 0x00, 0x00, 0x00, 0x00, 0x00, 0x00, 0x00, 0x00, 0x00, 0x00, 
	0x00, 0x00, 0x00, 0x00, 0x00, 0x00, 0x00, 0x00, 0x00, 0x00, 0x00, 0x00, 0x00, 0x00, 0x00, 0x00, 
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	0x00, 0x00, 0x00, 0x00, 0x00, 0x00, 0x00, 0x00, 0x00, 0x00, 0x00, 0x00, 0x00, 0x00, 0x00, 0x00
};
// 'Menu2_Resized', 128x52px
const unsigned char epd_bitmap_Menu2_Resized [] U8X8_PROGMEM = {
	0x00, 0x00, 0x00, 0x00, 0x00, 0x00, 0x00, 0x00, 0x00, 0x00, 0x00, 0x00, 0x00, 0x00, 0x00, 0x00, 
	0x00, 0x00, 0x00, 0x00, 0x00, 0x00, 0x00, 0x00, 0x00, 0x00, 0x00, 0x00, 0x00, 0x00, 0x00, 0x00, 
	0x00, 0x00, 0x00, 0x00, 0x00, 0x00, 0x00, 0x00, 0x00, 0x00, 0x00, 0x00, 0x00, 0x00, 0x00, 0x00, 
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	0x00, 0x00, 0x00, 0x00, 0x00, 0x00, 0x00, 0x00, 0x00, 0x00, 0x00, 0x00, 0x00, 0x00, 0x00, 0x00};
// 'Menu3_Resized', 128x52px
const unsigned char epd_bitmap_Menu3_Resized [] U8X8_PROGMEM = {
		0x00, 0x00, 0x00, 0x00, 0x00, 0x00, 0x00, 0x00, 0x00, 0x00, 0x00, 0x00, 0x00, 0x00, 0x00, 0x00, 
	0x00, 0x00, 0x00, 0x00, 0x00, 0x00, 0x00, 0x00, 0x00, 0x00, 0x00, 0x00, 0x00, 0x00, 0x00, 0x00, 
	0x00, 0x00, 0x00, 0x00, 0x00, 0x00, 0x00, 0x00, 0x00, 0x00, 0x00, 0x00, 0x00, 0x00, 0x00, 0x00, 
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	0x00, 0x00, 0x00, 0x00, 0x00, 0x00, 0x00, 0x00, 0x00, 0x00, 0x00, 0x00, 0x00, 0x00, 0x00, 0x00
};
// 'Menu4_Resized', 128x52px
const unsigned char epd_bitmap_Menu4_Resized [] U8X8_PROGMEM = {
		0x00, 0x00, 0x00, 0x00, 0x00, 0x00, 0x00, 0x00, 0x00, 0x00, 0x00, 0x00, 0x00, 0x00, 0x00, 0x00, 
	0x00, 0x00, 0x00, 0x00, 0x00, 0x00, 0x00, 0x00, 0x00, 0x00, 0x00, 0x00, 0x00, 0x00, 0x00, 0x00, 
	0x00, 0x00, 0x00, 0x00, 0x00, 0x00, 0x00, 0x00, 0x00, 0x00, 0x00, 0x00, 0x00, 0x00, 0x00, 0x00, 
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	0x00, 0x00, 0x00, 0x00, 0x00, 0x00, 0x00, 0x00, 0x00, 0x00, 0x00, 0x00, 0x00, 0x00, 0x00, 0x00
};

// Array of all bitmaps for convenience. (Total bytes used to store images in PROGMEM = 3392)
const int epd_bitmap_allArray_LEN = 4;
const unsigned char* epd_bitmap_allArray[4] = {
	epd_bitmap_Menu1_Resized,
	epd_bitmap_Menu2_Resized,
	epd_bitmap_Menu3_Resized,
	epd_bitmap_Menu4_Resized
};


PulseSensorPlayground pulseSensor;

RTC_DS3231 rtc;

double acc_x, acc_y, acc_z;

U8G2_SH1106_128X64_NONAME_F_HW_I2C u8g2(U8G2_R0, U8X8_PIN_NONE, 3, 2);

int menuType = -1; // -1 = Title 0 = Menu 1 = Any menu
int menuPosition = 0; // 0 = pulse; 1 = Rep; 2 = Steps; 3 = Location

int steps = 0;
int reps = 0;

bool beginStep = false;


void setup() {
  Serial.begin(115200); 
  Wire.begin();
  Wire.beginTransmission(MPU);
  Wire.write(0x6B);
  Wire.write(0);
  Wire.endTransmission(true);
  u8g2.begin();
  u8g2.setFont(u8g2_font_5x7_tr);
  pinMode(leftButton, INPUT_PULLUP);
  pinMode(selectButton, INPUT_PULLUP);
  pinMode(rightButton , INPUT_PULLUP);
  pulseSensor.analogInput(PulseWire);   
	pulseSensor.setThreshold(Threshold); 
  pulseSensor.begin();
  rtc.begin();
  rtc.adjust(DateTime(F(__DATE__), F(__TIME__)));

  

}

void loop() {
  u8g2.setBitmapMode(false);
  u8g2.firstPage();
  DateTime now = rtc.now();
  char time[8];
  char date[16];
  sprintf(time, "%02d:%02d", now.hour(), now.minute());
  sprintf(date, "%02d/%02d/%02d", now.day(), now.month(), (now.year()%100));

  u8g2.drawStr(5, 10, time); 
  u8g2.drawStr(85, 10, date);
  
  
  

  // Calculate the steps by measuring the y acceleration
  Wire.beginTransmission(MPU);
  Wire.write(0x3B);
  Wire.endTransmission(false);
  Wire.requestFrom(MPU, 6, true);
  acc_x = (Wire.read()<<8 | Wire.read()) / 16384.0;
  acc_y =  (Wire.read()<<8 | Wire.read()) / 16384.0; 
  acc_z = (Wire.read()<<8 | Wire.read()) / 16384.0;


  double formula = (pow(acc_x, 2) + pow(acc_y, 2) + pow(acc_z, 2));
  double acc_vector = sqrt(formula);
  
  if(acc_vector < 1.0)
  {
    beginStep = true;
  }
  if(beginStep && acc_vector > 1.2)
  {
    beginStep = false;
    steps++;
  }

  Serial.println(steps);

  int leftButtonClicked = digitalRead(leftButton);
  int selectButtonClicked = digitalRead(selectButton);
  int rightButtonClicked = digitalRead(rightButton);

  if(!leftButtonClicked)
  {

    if(menuType == 0)
    {
        menuPosition--;
    }
    else if(menuType == -1)
    {
      menuType++;
    }
    else
    {
      menuType--;
    }
    
    if(menuPosition < 0)
    {
      menuPosition = 3;
    }
    
  }
  
  if(!rightButtonClicked)
  {
    if(menuType == 0)
    {
        menuPosition++;
    }
    else if(menuType == -1)
    {
      menuType++;
    }
    else {
      menuType--;
    }
    
    
    if(menuPosition > 3)
    {
      menuPosition = 0;
    }
    
  }

  if(!selectButtonClicked)
  {
    switch(menuType)
    {
      case -1:
        menuType++;
        break;
      case 0:
        menuType++;
        break;
      case 1:
        ResetValues();
        break;
      
    }
  }

  do {

    if(menuType == -1)
    {
      u8g2.drawStr(42, 32, "Mega Watch");
    }
    else if(menuType == 0)
    {
        u8g2.drawXBMP(0, 12, 128, 64, epd_bitmap_allArray[menuPosition]);
    }
    else if(menuType = 1)
    {
      displayFunctionality();
    }
    
    
    
  }while (u8g2.nextPage());
  

}

bool bRep = false;
void displayFunctionality()
{

  Serial.println(menuPosition);

  if(menuPosition == 0)
  {
    int myBPM = pulseSensor.getBeatsPerMinute();
        
        char bpm[12];
        sprintf(bpm, "%d", myBPM);
        u8g2.drawStr(40, 32, "Pulse: ");
        u8g2.drawStr(72, 32, bpm);
        delay(500);
        
  }
  else if(menuPosition == 1)
  {
    Wire.beginTransmission(MPU);
    Wire.write(0x3B);
    Wire.endTransmission(false);
    Wire.requestFrom(MPU, 6, true);
    acc_x = (Wire.read()<<8 | Wire.read()) / 16384.0;
    acc_y =  (Wire.read()<<8 | Wire.read()) / 16384.0; 
    acc_z = (Wire.read()<<8 | Wire.read()) / 16384.0;

    double formula = (pow(acc_x, 2) + pow(acc_y, 2) + pow(acc_z, 2));
    double acc_vector = sqrt(formula);
    

    if(acc_vector < 1.0)
    {
      bRep = true;
    }
    else if(bRep && acc_vector > 1.3)
    {
      reps++;
    }
    char rep_cnt[12];
    sprintf(rep_cnt, "%d", reps);
    u8g2.drawStr(40, 32, "Reps: ");
    u8g2.drawStr(72, 32, rep_cnt);

  }
  else if(menuPosition == 2)
  {
    
    char _steps[6];
    sprintf(_steps, "%d", steps);
    u8g2.drawStr(40, 32, "Steps: ");
    u8g2.drawStr(72, 32, _steps);
    
  }
  else if(menuPosition == 3)
  {
    u8g2.drawStr(16, 40, "Work in Progress...");
  }

  
}

void ResetValues()
{
  if(menuPosition == 1)
  {
    reps = 0;
  }
  else if(menuPosition == 2)
  {
    steps = 0;
  }
}



